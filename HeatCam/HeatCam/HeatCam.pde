/*
  Visualizing the Panasonic Grid-EYE Sensor Data using Processing
  By: Nick Poole
  SparkFun Electronics
  Date: January 12th, 2018
  
  MIT License: Permission is hereby granted, free of charge, to any person obtaining a copy of this 
  software and associated documentation files (the "Software"), to deal in the Software without 
  restriction, including without limitation the rights to use, copy, modify, merge, publish, 
  distribute, sublicense, and/or sell copies of the Software, and to permit persons to whom the 
  Software is furnished to do so, subject to the following conditions:

  The above copyright notice and this permission notice shall be included in all copies or 
  substantial portions of the Software.

  THE SOFTWARE IS PROVIDED "AS IS", WITHOUT WARRANTY OF ANY KIND, EXPRESS OR IMPLIED, INCLUDING 
  BUT NOT LIMITED TO THE WARRANTIES OF MERCHANTABILITY, FITNESS FOR A PARTICULAR PURPOSE AND 
  NONINFRINGEMENT. IN NO EVENT SHALL THE AUTHORS OR COPYRIGHT HOLDERS BE LIABLE FOR ANY CLAIM, 
  DAMAGES OR OTHER LIABILITY, WHETHER IN AN ACTION OF CONTRACT, TORT OR OTHERWISE, ARISING FROM, 
  OUT OF OR IN CONNECTION WITH THE SOFTWARE OR THE USE OR OTHER DEALINGS IN THE SOFTWARE.
  
  Feel like supporting our work? Buy a board from SparkFun!
  https://www.sparkfun.com/products/14568
  
  This example is intended as a companion sketch to the Arduino sketch found in the same folder.
  Once the accompanying code is running on your hardware, run this Processing sketch. 
  This Processing sketch will receive the comma separated values generated by the Arduino code and
  use them to generate a thermal image.
  
  Hardware Connections:
  Attach the Qwiic Shield to your Arduino/Photon/ESP32 or other
  Plug the sensor onto the shield
*/

import processing.serial.*;

String myString = null;
Serial myPort;  // The serial port
String txtToDraw ="";
float[][] matrix = { { 1.f/9, 1.f/9, 1.f/9 },
                     { 1.f/9, 1.f/9, 1.f/9 },
                     { 1.f/9, 1.f/9, 1.f/9 } }; 
float[] temps =  {0,0,0,0,0,0,0,0,0,0,0,0,0,0,0,0,0,0,0,0,0,0,0,0,0,0,0,0,0,0,0,0,0,0,0,0,0,0,0,0,0,0,0,0,0,0,0,0,0,0,0,0,0,0,0,0,0,0,0,0,0,0,0,0};
float[] buf =  {0,0,0,0,0,0,0,0,0,0,0,0,0,0,0,0,0,0,0,0,0,0,0,0,0,0,0,0,0,0,0,0,0,0,0,0,0,0,0,0,0,0,0,0,0,0,0,0,0,0,0,0,0,0,0,0,0,0,0,0,0,0,0,0};

  boolean hasPresence = false;
  
  float maxRoomTemp = 22;
  
// The statements in the setup() function 
// execute once when the program begins
void setup() {
  size(400, 400);  // Size must be the first statement
  noStroke();
  frameRate(30);
  
  // Print a list of connected serial devices in the console
  printArray(Serial.list());
  // Depending on where your GridEYE falls on this list, you
  // may need to change Serial.list()[0] to a different number
  myPort = new Serial(this, "/dev/ttyUSB0", 115200);
  myPort.clear();
  // Throw out the first chunk in case we caught it in the 
  // middle of a frame
  myString = myPort.readStringUntil(13);
  myString = null;
  // change to HSB color mode, this will make it easier to color
  // code the temperature data
  colorMode(HSB, 360, 100, 100);
  
}

// The statements in draw() are executed until the 
// program is stopped. Each statement is executed in 
// sequence and after the last line is read, the first 
// line is executed again.

void draw() { 
  
  // When there is a sizeable amount of data on the serial port
  // read everything up to the first linefeed
  while(myPort.available() >0){

  myString = myPort.readStringUntil(13);
    //println(myString);
 if((myString!=null) && 
 myString.trim().startsWith("osc : sending/mat")){
  // generate an array of strings that contains each of the comma
  // separated values
  String splitString[] = splitTokens(myString, ",");
//  print("len ");
//  println(splitString.length);
  // for each of the 64 values, map the temperatures between 20C and 40C
  // to the blue through red portion of the color space
    float maximum = 0;
    float minimum = 100;
    float sum = 0;
    for(int q = 0; q < 64; q++){
   temps[q] = float(splitString[q+1]);
    maximum = max(temps[q],maximum);
        minimum = min(temps[q],minimum);
        sum+=(temps[q]>=maxRoomTemp?temps[q]:0) ;
    }
    float mean = sum/64;
    txtToDraw = Integer.toString((int)mean);
    txtToDraw+=" : "+ Integer.toString((int)maximum);
  float d = 5;
  print(minimum);
  print("     ");
  print(maximum);
  print("     ");
  println(mean);
  float pctHeat = 0.5;
   hasPresence = mean >1; 
  minimum = 20;// maxRoomTemp;
  //maximum = mean;
  maximum =30;// max(maxRoomTemp + 2,maximum);
  //if(maximum>22){
    int pow = 1;
  for(int q = 0; q < 64; q++){
   
    temps[q] = map(temps[q], minimum,maximum, 00, 1);// map(float(splitString[q]), 20, 40, 240, 360);
  /*  temps[q] = constrain(temps[q],0,1);
    temps[q] = pow(temps[q],pow);
    temps[q] = constrain(temps[q],0,1);
    */
    //temps[q-1] = map(float(splitString[q]), 0, +d, 00, 100);
  }
  //}
  break;
  
 }
  }
  
/*
  for(int x = 0 ; x < 8 ; x++){
    for(int y = 0 ; y < 8 ; y++){
      
      buf[y*8+x] = convolution(x, y,matrix, 3, temps);
    }
   }
   for(int i = 0 ; i < 64 ; i++){
     temps[i] = buf[i];
   }
    
  for(int x = 0 ; x < 8 ; x++){
    for(int y = 0 ; y < 8 ; y++){
      
      buf[y*8+x] = convolution(x, y,matrix, 3, temps);
    }
   }
for(int i = 0 ; i < 64 ; i++){
     temps[i] = buf[i];
   }

*/

for(int i = 0 ; i < 64 ; i++){
     buf[i] = temps[i];
   }


   int iMax = -1;
   if(hasPresence){
   float maxV = temps[0];
      for(int i = 0 ; i < 64 ; i++){
     if(temps[i]>maxV){
       maxV = temps [i];
       iMax = i;
     }
   }
   }
  // Prepare variables needed to draw our heatmap
  int y = 0;
  int x = 400-49;
  int i = 0;
  background(0);   // Clear the screen with a black background
  
  //boolean upsample = false;
  
  // each GridEYE pixel will be represented by a 50px square: 
  // because 50 x 8 = 400, we draw squares until our y location
  // is 400
  while(y <400 ){
  
    
  // for each increment in the y direction, draw 8 boxes in the 
  // x direction, creating a 64 pixel matrix
  while(x >=0){
  // before drawing each pixel, set our paintcan color to the 
  // appropriate mapped color value

float t = buf[i];
 // float t =convolution(x/50, y/50, matrix, 3, temps);

      if(i==iMax){
    fill(0,100,100);
  }
  else{
  fill(100, 100, t*100);
  }
  rect(x,y,50,50);

  x = x - 50;
  i++;
  }
  
  y = y + 50;
  x = 400-49;
  }
  
  
  
  // Add a gaussian blur to the canvas in order to create a rough
  // visual interpolation between pixels.
  //filter(BLUR,10);
  textSize(50);
  fill(hasPresence?300:0,100,100);
  text(txtToDraw,100,100);
 if(frameRate<25)text( Integer.toString((int)frameRate), 0 ,50);
 
} 

float convolution(int x, int y, float[][] matrix, int matrixsize, float[] arr)
{
float c = 0;
  int offset = matrixsize / 2;
  for (int i = 0; i < matrixsize; i++){
    for (int j= 0; j < matrixsize; j++){
      // What pixel are we testing
      int xloc = constrain(x+i-offset,0,7);
      int yloc = constrain(y+j-offset,0,7);
      int loc = xloc + 8*yloc;

      // Make sure we haven't walked off our image, we could do better here
      loc = constrain(loc,0,64-1);
      // Calculate the convolution
      c += arr[loc] * matrix[i][j];
      
    }
  }
        
  // Make sure RGB is within range
  //c = constrain(c, 0, 1.f);

  return c;
}
